## conf/machine/microzed.conf
```bitbake
#@TYPE: Machine
#@NAME: microzed
#@DESCRIPTION: Machine support for MicroZed board. (http://www.zedboard.org/product/microzed)

PREFERRED_PROVIDER_virtual/kernel = "linux-xlnx"
PREFERRED_VERSION_linux-xlnx = "3.8%"
PREFERRED_VERSION_linux-yocto ?= "3.8%"
PREFERRED_VERSION_linux-yocto-tiny ?= "3.8%"

PREFERRED_PROVIDER_virtual/bootloader = "u-boot-xlnx"
PREFERRED_PROVIDER_u-boot = "u-boot-xlnx"
PREFERRED_VERSION_u-boot-xlnx = "v2013.01%"

require conf/machine/include/tune-zynq.inc

IMAGE_FSTYPES ?= "cpio tar.gz ext2 ext2.gz.u-boot ext2.gz"
IMAGE_CLASSES += "image_types_uboot"

UBOOT_MACHINE = "zynq_zed_config"

SERIAL_CONSOLE = "115200 ttyPS0"
```
